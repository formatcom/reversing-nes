## Kconfig
```kconfig
mainmenu "Reversing Nes configuration"

config APP_NAME
	string "Change name to binary output"
	default "reversing-nes"

menu "Gui"

config DISPLAY_SCALE
	int "Scale display"
	default 3

endmenu

source "console/Kconfig"
source "debugger/Kconfig"
source "nes/Kconfig"
source "platforms/Kconfig"
```

## console/Kconfig
```kconfig
menu "Console Configuration"

config CONSOLE_BUFFER_LEN
	int "Buffer size for the command input"
	default 100
	range    16  256

endmenu
```

## debugger/Kconfig
```kconfig
menu "Debugger Configuration"

config DEBUGGER_SRC
	string "select support"
	default "dummy"

endmenu
```

## platforms/Kconfig
```kconfig
menu "Platform Configuration"

config PLATFORM_SRC
	string "select platform"
	default "sdl"

endmenu
```
